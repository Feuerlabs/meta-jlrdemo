## conf/layer.conf
```bitbake
# We have a conf and classes directory, add to BBPATH
BBPATH := "${BBPATH}:${LAYERDIR}"

# We have a recipes directory, add to BBFILES
BBFILES := "${BBFILES} ${LAYERDIR}/recipes-*/*/*.bb \
	${LAYERDIR}/recipes-*/*/*.bbappend"

# Please replace jlrdemo in the three lines below with 
# the chosen name for the application 
BBFILE_COLLECTIONS += "jlrdemo"
BBFILE_PATTERN_jlrdemo := "^${LAYERDIR}/"
BBFILE_PRIORITY_jlrdemo = "7"
```
